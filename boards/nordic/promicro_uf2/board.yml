## boards/nordic/promicro_uf2/board.yml
```yaml
# Copyright (c) 2024 Nordic Semiconductor ASA
# SPDX-License-Identifier: Apache-2.0

board:
  name: promicro_uf2
  vendor: nordic
  socs:
    - name: nrf52840
      variants:
      - name: 'spi'
      - name: 'spi_lsm6dsr'
```
